/dts-v1/;
/plugin/;

/{
    compatible = "brcm,bcm2709";
    
    fragment@0 
    {
      target=<&spi0>;
      __overlay__
      {
	m25p80@0 
	{
	  status = "disabled";
	};
      };
    };
    
    fragment@1
    {
      target=<&spi0>;
      __overlay__
      {
	mcp3008@0 
	{
	  status = "ok";
	};
      };
    };
    
};